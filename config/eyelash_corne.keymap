#include <dt-bindings/zmk/mouse.h>
#include <input/processors.dtsi>
#include <behaviors.dtsi>
#include <dt-bindings/zmk/bt.h>
#include <dt-bindings/zmk/keys.h>
#include <dt-bindings/zmk/outputs.h>
#include <dt-bindings/zmk/pointing.h>
#include <dt-bindings/zmk/rgb.h>

/*

   &mmv_input_listener {
       input-processors = <&zip_xy_scaler 2 1>;
   };

   &msc_input_listener {
       input-processors = <&zip_xy_scaler 2 1>;
   };

 */

#define ZMK_MOUSE_DEFAULT_MOVE_VAL 1200  // 600
#define ZMK_MOUSE_DEFAULT_SCRL_VAL 20    // 10

/ {
    behaviors {
        pRight: pRight {
            compatible = "zmk,behavior-tap-dance";
            display-name = "Shift/Caps Lock Tap Dance";
            #binding-cells = <0>;
            bindings =
                <&kp RIGHT_PARENTHESIS>,
                <&kp RIGHT_BRACKET>,
                <&kp RIGHT_BRACE>;

            label = ")]}";
        };

        pLeft: pLeft {
            compatible = "zmk,behavior-tap-dance";
            label = "([{";
            #binding-cells = <0>;
            bindings =
                <&kp LEFT_PARENTHESIS>,
                <&kp LEFT_BRACKET>,
                <&kp LEFT_BRACE>;
        };

        semi_colon: semi_colon {
            compatible = "zmk,behavior-tap-dance";
            label = "; :";
            #binding-cells = <0>;
            bindings = <&kp SEMICOLON>, <&kp COLON>;
        };

        qdq: qdq {
            compatible = "zmk,behavior-tap-dance";
            label = "' ", , , ";

            #binding-cells =, <0>;

            bindings = <&kp SQT>, <&kp DQT>;
        };

        comma: comma {
            compatible = "zmk,behavior-tap-dance";
            label = ", <";
            #binding-cells = <0>;
            bindings = <&kp COMMA>, <&kp LESS_THAN>;
        };

        period: period {
            compatible = "zmk,behavior-tap-dance";
            label = ". >";
            #binding-cells = <0>;
            bindings = <&kp PERIOD>, <&kp GREATER_THAN>;
        };

        slash: slash {
            compatible = "zmk,behavior-tap-dance";
            label = "/ ?";
            #binding-cells = <0>;
            bindings = <&kp SLASH>, <&kp QUESTION>;
        };
    };

    rgb_encoder: rgb_encoder {
        compatible = "zmk,behavior-sensor-rotate";
        #sensor-binding-cells = <0>;
        bindings = <&rgb_ug RGB_BRI>, <&rgb_ug RGB_BRD>;
    };

    scroll_encoder: scroll_encoder {
        compatible = "zmk,behavior-sensor-rotate";
        #sensor-binding-cells = <0>;
        bindings = <&msc SCRL_DOWN>, <&msc SCRL_UP>;

        tap-ms = <30>;
    };

    keymap {
        compatible = "zmk,keymap";

        base {
            display-name = "QWERTY";
            bindings = <
&kp ESCAPE      &kp Q  &kp W  &kp E      &kp R         &kp T                            &kp UP                &kp Y        &kp U         &kp I      &kp O    &kp P        &kp BSPC
&kp TAB         &kp A  &kp S  &kp D      &kp F         &kp G                  &kp LEFT  &kp ENTER  &kp RIGHT  &kp H        &kp J         &kp K      &kp L    &semi_colon  &qdq
&sk LEFT_SHIFT  &kp Z  &kp X  &kp C      &kp V         &kp B        &trans              &kp DOWN              &kp N        &kp M         &comma     &period  &slash       &sk LEFT_SHIFT
                              &kp LCTRL  &kp LEFT_GUI  &lt 1 ENTER                                            &lt 2 SPACE  &kp LEFT_ALT  &kp K_APP
            >;
        };

        lower {
            display-name = "lower";
            bindings = <
&kp GRAVE     &none           &mkp LCLK       &mmv MOVE_UP    &mkp RCLK        &none                                     &mmv MOVE_UP                     &kp HOME   &none           &kp UP_ARROW    &none      &kp PAGE_UP  &trans
&kp INT1      &msc SCRL_LEFT  &mmv MOVE_LEFT  &mmv MOVE_DOWN  &mmv MOVE_RIGHT  &msc SCRL_RIGHT           &mmv MOVE_LEFT  &mkp LCLK       &mmv MOVE_RIGHT  &kp END    &kp LEFT_ARROW  &kp DOWN_ARROW  &kp RIGHT  &kp PG_DN    &kp UNDERSCORE
&kp CAPSLOCK  &none           &msc SCRL_UP    &none           &msc SCRL_DOWN   &none            &none                    &mmv MOVE_DOWN                   &kp EQUAL  &none           &none           &none      &kp PIPE     &trans
                                              &trans          &trans           &trans                                                                     &trans     &trans          &trans
            >;
        };

        raise {
            display-name = "raise";
            bindings = <
&kp TILDE   &kp NUMBER_1  &kp NUMBER_2  &kp NUMBER_3  &kp NUMBER_4  &kp NUMBER_5                           &mmv MOVE_UP                     &kp NUMBER_6  &kp NUMBER_7  &kp NUMBER_8  &kp NUMBER_9  &kp NUMBER_0    &kp DEL
&kp INT2    &none         &none         &none         &none         &none                  &mmv MOVE_LEFT  &mkp LCLK       &mmv MOVE_RIGHT  &kp PLUS      &kp NUMBER_4  &kp NUMBER_5  &kp NUMBER_6  &kp UNDERSCORE  &kp INS
&caps_word  &none         &none         &none         &none         &none         &none                    &mmv MOVE_DOWN                   &kp MINUS     &kp NUMBER_1  &kp NUMBER_2  &kp NUMBER_3  &kp BSLH        &trans
                                        &trans        &trans        &trans                                                                  &trans        &trans        &trans
            >;
        };

        ADJ {
            display-name = "ADJ";
            bindings = <
&bootloader      &kp EXCLAMATION  &kp AT_SIGN  &kp HASH  &kp DOLLAR  &kp PERCENT                            &mmv MOVE_UP                     &kp CARET  &kp AMPERSAND  &kp ASTERISK  &pLeft  &pRight         &bootloader
&kp PAUSE_BREAK  &none            &none        &none     &none       &none                  &mmv MOVE_LEFT  &mkp LCLK       &mmv MOVE_RIGHT  &none      &none          &none         &none   &none           &none
&to 4            &studio_unlock   &none        &none     &none       &none        &trans                    &mmv MOVE_DOWN                   &none      &none          &none         &none   &studio_unlock  &to 4
                                               &trans    &trans      &trans                                                                  &trans     &trans         &trans
            >;
        };

        layer_4 {
            display-name = "NUMBER";
            bindings = <
&sys_reset    &rgb_ug RGB_TOG  &none            &none            &none            &none                                     &mmv MOVE_UP                     &bt BT_SEL 0     &bt BT_SEL 1     &bt BT_SEL 2     &bt BT_SEL 3     &bt BT_SEL 4  &bt BT_CLR
&out OUT_BLE  &rgb_ug RGB_HUI  &rgb_ug RGB_SAI  &rgb_ug RGB_BRI  &rgb_ug RGB_EFF  &rgb_ug RGB_SPI           &mmv MOVE_LEFT  &mkp LCLK       &mmv MOVE_RIGHT  &none            &none            &none            &none            &none         &none
&out OUT_USB  &rgb_ug RGB_HUD  &rgb_ug RGB_SAD  &rgb_ug RGB_BRD  &rgb_ug RGB_EFR  &rgb_ug RGB_SPD  &none                    &mmv MOVE_DOWN                   &rgb_ug RGB_EFR  &rgb_ug RGB_SPI  &rgb_ug RGB_BRI  &rgb_ug RGB_BRD  &none         &bt BT_CLR_ALL
                                                &trans           &trans           &trans                                                                     &trans           &trans           &trans
            >;
        };
    };
};
